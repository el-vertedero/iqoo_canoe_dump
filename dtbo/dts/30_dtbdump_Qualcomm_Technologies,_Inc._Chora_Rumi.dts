/dts-v1/;

/ {
	model = "Qualcomm Technologies, Inc. Chora Rumi";
	compatible = "qcom,chora-rumi\0qcom,chora\0qcom,rumi";
	qcom,msm-id = <0x2d4 0x10000>;
	qcom,board-id = <0x0f 0x00>;

	fragment@0 {
		target = <0xffffffff>;

		__overlay__ {
			bootargs = "printk.devkmsg=on loglevel=8 nokaslr kpti=0 log_buf_len=256K swiotlb=0 slub_debug=- cpufreq.default_governor=performance";
		};
	};

	fragment@1 {
		target = <0xffffffff>;

		__overlay__ {
			clock-frequency = <0x4c4b40>;
		};
	};

	fragment@2 {
		target = <0xffffffff>;

		__overlay__ {
			clock-frequency = <0x4c4b40>;
		};
	};

	fragment@3 {
		target = <0xffffffff>;

		__overlay__ {
			enable-method = "spin-table";
			cpu-release-addr = <0x00 0x90000000>;
		};
	};

	fragment@4 {
		target = <0xffffffff>;

		__overlay__ {
			enable-method = "spin-table";
			cpu-release-addr = <0x00 0x90000000>;
		};
	};

	fragment@5 {
		target = <0xffffffff>;

		__overlay__ {
			enable-method = "spin-table";
			cpu-release-addr = <0x00 0x90000000>;
		};
	};

	fragment@6 {
		target = <0xffffffff>;

		__overlay__ {
			enable-method = "spin-table";
			cpu-release-addr = <0x00 0x90000000>;
		};
	};

	fragment@7 {
		target = <0xffffffff>;

		__overlay__ {
			enable-method = "spin-table";
			cpu-release-addr = <0x00 0x90000000>;
		};
	};

	fragment@8 {
		target = <0xffffffff>;

		__overlay__ {
			enable-method = "spin-table";
			cpu-release-addr = <0x00 0x90000000>;
		};
	};

	fragment@9 {
		target = <0xffffffff>;

		__overlay__ {
			enable-method = "spin-table";
			cpu-release-addr = <0x00 0x90000000>;
		};
	};

	fragment@10 {
		target = <0xffffffff>;

		__overlay__ {
			enable-method = "spin-table";
			cpu-release-addr = <0x00 0x90000000>;
		};
	};

	fragment@11 {
		target = <0xffffffff>;

		__overlay__ {
			status = "disabled";
		};
	};

	__fixups__ {
		chosen = "/fragment@0:target:0";
		arch_timer = "/fragment@1:target:0";
		memtimer = "/fragment@2:target:0";
		CPU0 = "/fragment@3:target:0";
		CPU1 = "/fragment@4:target:0";
		CPU2 = "/fragment@5:target:0";
		CPU3 = "/fragment@6:target:0";
		CPU4 = "/fragment@7:target:0";
		CPU5 = "/fragment@8:target:0";
		CPU6 = "/fragment@9:target:0";
		CPU7 = "/fragment@10:target:0";
		psci = "/fragment@11:target:0";
	};
};
